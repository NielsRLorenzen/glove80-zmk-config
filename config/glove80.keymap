/*
 * Copyright (c) 2020 The ZMK Contributors
 * Copyright (c) 2023 Innaworks Development Limited, trading as MoErgo
 *
 * SPDX-License-Identifier: MIT
 */
/* THIS FILE WAS GENERATED BY GLOVE80 LAYOUT EDITOR
 *
 * This file was generated automatically. You may or may not want to
 * edit it directly.
 */

#include <behaviors.dtsi>

/* Include all behaviour includes needed */

#include <dt-bindings/zmk/bt.h>
#include <dt-bindings/zmk/keys.h>
#include <dt-bindings/zmk/outputs.h>
#include <dt-bindings/zmk/rgb.h>

/* Automatically generated layer name #define */

#define LAYER_Base 0
#define LAYER_Symbols 1
#define LAYER_Numeric 2
#define LAYER_Mouse 3
#define LAYER_Nav 4
#define LAYER_Lower 5
#define LAYER_Magic 6

/* To deal with the situation where there is no Lower layer, to keep &lower happy */
#ifndef LAYER_Lower
#define LAYER_Lower 0
#endif

/ {
    /* Glove80 system behavior & macros */

    behaviors {
        // For the "layer" key, it'd nice to be able to use it as either a shift or a toggle.
        // Configure it as a tap dance, so the first tap (or hold) is a &mo and the second tap is a &to

        lower: lower {
            compatible = "zmk,behavior-tap-dance";
            label = "LAYER_TAP_DANCE";
            #binding-cells = <0>;
            tapping-term-ms = <200>;
            bindings = <&mo 0>, <&to 0>;
        };
    };
};

&lt {
    require-prior-idle-ms = <100>;
    quick-tap-ms = <70>;
};

/ {
    macros {
        rgb_ug_status_macro: rgb_ug_status_macro {
            label = "RGB_UG_STATUS";
            compatible = "zmk,behavior-macro";
            #binding-cells = <0>;
            bindings = <&rgb_ug RGB_STATUS>;
        };
        bt_0: bt_0 {
            label = "BT_0";
            compatible = "zmk,behavior-macro";
            #binding-cells = <0>;
            bindings = <&out OUT_BLE &bt BT_SEL 0>;
        };
        bt_1: bt_1 {
            label = "BT_1";
            compatible = "zmk,behavior-macro";
            #binding-cells = <0>;
            bindings = <&out OUT_BLE &bt BT_SEL 1>;
        };
        bt_2: bt_2 {
            label = "BT_2";
            compatible = "zmk,behavior-macro";
            #binding-cells = <0>;
            bindings = <&out OUT_BLE &bt BT_SEL 2>;
        };
        bt_3: bt_3 {
            label = "BT_3";
            compatible = "zmk,behavior-macro";
            #binding-cells = <0>;
            bindings = <&out OUT_BLE &bt BT_SEL 3>;
        };
    };
};

/ {
    magic: magic {
        compatible = "zmk,behavior-hold-tap";
        label = "MAGIC_HOLD_TAP";
        #binding-cells = <2>;
        flavor = "tap-preferred";
        tapping-term-ms = <200>;
        bindings = <&mo>, <&rgb_ug_status_macro>;
    };
};

/* #define for key positions */

#define POS_LH_T1 52
#define POS_LH_T2 53
#define POS_LH_T3 54
#define POS_LH_T4 69
#define POS_LH_T5 70
#define POS_LH_T6 71
#define POS_LH_C1R2 15
#define POS_LH_C1R3 27
#define POS_LH_C1R4 39
#define POS_LH_C1R5 51
#define POS_LH_C2R1 4
#define POS_LH_C2R2 14
#define POS_LH_C2R3 26
#define POS_LH_C2R4 38
#define POS_LH_C2R5 50
#define POS_LH_C2R6 68
#define POS_LH_C3R1 3
#define POS_LH_C3R2 13
#define POS_LH_C3R3 25
#define POS_LH_C3R4 37
#define POS_LH_C3R5 49
#define POS_LH_C3R6 67
#define POS_LH_C4R1 2
#define POS_LH_C4R2 12
#define POS_LH_C4R3 24
#define POS_LH_C4R4 36
#define POS_LH_C4R5 48
#define POS_LH_C4R6 66
#define POS_LH_C5R1 1
#define POS_LH_C5R2 11
#define POS_LH_C5R3 23
#define POS_LH_C5R4 35
#define POS_LH_C5R5 47
#define POS_LH_C5R6 65
#define POS_LH_C6R1 0
#define POS_LH_C6R2 10
#define POS_LH_C6R3 22
#define POS_LH_C6R4 34
#define POS_LH_C6R5 46
#define POS_LH_C6R6 64
#define POS_RH_T1 57
#define POS_RH_T2 56
#define POS_RH_T3 55
#define POS_RH_T4 74
#define POS_RH_T5 73
#define POS_RH_T6 72
#define POS_RH_C1R2 16
#define POS_RH_C1R3 28
#define POS_RH_C1R4 40
#define POS_RH_C1R5 58
#define POS_RH_C2R1 5
#define POS_RH_C2R2 17
#define POS_RH_C2R3 29
#define POS_RH_C2R4 41
#define POS_RH_C2R5 59
#define POS_RH_C2R6 75
#define POS_RH_C3R1 6
#define POS_RH_C3R2 18
#define POS_RH_C3R3 30
#define POS_RH_C3R4 42
#define POS_RH_C3R5 60
#define POS_RH_C3R6 76
#define POS_RH_C4R1 7
#define POS_RH_C4R2 19
#define POS_RH_C4R3 31
#define POS_RH_C4R4 43
#define POS_RH_C4R5 61
#define POS_RH_C4R6 77
#define POS_RH_C5R1 8
#define POS_RH_C5R2 20
#define POS_RH_C5R3 32
#define POS_RH_C5R4 44
#define POS_RH_C5R5 62
#define POS_RH_C5R6 78
#define POS_RH_C6R1 9
#define POS_RH_C6R2 21
#define POS_RH_C6R3 33
#define POS_RH_C6R4 45
#define POS_RH_C6R5 63
#define POS_RH_C6R6 79

/* Custom Defined Behaviors */

/ {
    macros {
        left_click: left_click {
            label = "left_click";
            compatible = "zmk,behavior-macro";
            #binding-cells = <0>;
            bindings = <&kp KP_SLASH &kp KP_N5>;
        };
        left_double_click: left_double_click {
            label = "left_double_click";
            compatible = "zmk,behavior-macro";
            #binding-cells = <0>;
            bindings = <&kp KP_SLASH &kp KP_PLUS>;
        };
        right_click: right_click {
            label = "right_click";
            compatible = "zmk,behavior-macro";
            #binding-cells = <0>;
            bindings = <&kp KP_MINUS &kp KP_N5>;
        };
        both_click: both_click {
            label = "both_click";
            compatible = "zmk,behavior-macro";
            #binding-cells = <0>;
            bindings = <&kp KP_MULTIPLY &kp KP_N5>;
        };
        danish_aa: danish_aa {
            compatible = "zmk,behavior-macro";
            #binding-cells = <0>;
            bindings = <&kp LG(SPACE) &kp LEFT_BRACKET &kp LG(SPACE)>;
            label = "DANISH_AA";
        };
        danish_cap_aa: danish_cap_aa {
            compatible = "zmk,behavior-macro";
            #binding-cells = <0>;
            bindings = <&kp LG(SPACE) &kp LS(LEFT_BRACKET) &kp LG(SPACE)>;
            label = "DANISH_CAP_AA";
        };
        danish_ae: danish_ae {
            compatible = "zmk,behavior-macro";
            #binding-cells = <0>;
            bindings = <&kp LG(SPACE) &kp SEMI &kp LG(SPACE)>;
            label = "DANISH_AE";
        };
        danish_cap_ae: danish_cap_ae {
            compatible = "zmk,behavior-macro";
            #binding-cells = <0>;
            bindings = <&kp LG(SPACE) &kp LS(SEMI) &kp LG(SPACE)>;
            label = "DANISH_CAP_AE";
        };
        danish_oe: danish_oe {
            compatible = "zmk,behavior-macro";
            #binding-cells = <0>;
            bindings = <&kp LG(SPACE) &kp SINGLE_QUOTE &kp LG(SPACE)>;
            label = "DANISH_OE";
        };
        danish_cap_oe: danish_cap_oe {
            compatible = "zmk,behavior-macro";
            #binding-cells = <0>;
            bindings = <&kp LG(SPACE) &kp LS(SINGLE_QUOTE) &kp LG(SPACE)>;
            label = "DANISH_CAP_OE";
        };
    };
};


/ {
    behaviors {
        danish_aa_AA: danish_aa_AA {
            compatible = "zmk,behavior-mod-morph";
            label = "DANISH_AA_AA";
            bindings = <&danish_aa>, <&danish_cap_aa>;

            #binding-cells = <0>;
            mods = <(MOD_LSFT|MOD_RSFT)>;
        };
        home_mod_left: home_mod_left {
            compatible = "zmk,behavior-hold-tap";
            label = "HOME_MOD_LEFT";
            bindings = <&kp>, <&kp>;

            #binding-cells = <2>;
            hold-trigger-key-positions = <5 6 7 8 9 16 17 18 19 20 21 28 29 30 31 32 33 40 41 42 43 44 45 55 56 57 58 59 60 61 62 63 72 73 74 75 76 77 78 79 52 53 54 69 70 71>;
            require-prior-idle-ms = <100>;
            tapping-term-ms = <200>;
            flavor = "tap-preferred";
        };
        home_mod_right: home_mod_right {
            compatible = "zmk,behavior-hold-tap";
            label = "HOME_MOD_RIGHT";
            bindings = <&kp>, <&kp>;

            #binding-cells = <2>;
            tapping-term-ms = <200>;
            require-prior-idle-ms = <100>;
            flavor = "tap-preferred";
            hold-trigger-key-positions = <0 1 2 3 4 10 11 12 13 14 15 22 23 24 25 26 27 34 35 36 37 38 39 46 47 48 49 50 51 52 53 54 64 65 66 67 68 69 70 71 55 56 57 72 73 74>;
        };
        danish_ae_AE: danish_ae_AE {
            compatible = "zmk,behavior-mod-morph";
            label = "DANISH_AE_AE";
            bindings = <&danish_ae>, <&danish_cap_ae>;

            #binding-cells = <0>;
            mods = <(MOD_LSFT|MOD_RSFT)>;
        };
        danish_oe_OE: danish_oe_OE {
            compatible = "zmk,behavior-mod-morph";
            label = "DANISH_OE_OE";
            bindings = <&danish_oe>, <&danish_cap_oe>;

            #binding-cells = <0>;
            mods = <(MOD_LSFT|MOD_RSFT)>;
        };
    };
};

/* Automatically generated keymap */
    keymap {
        compatible = "zmk,keymap";

        layer_Base {
            bindings = <
&magic 6 0  &kp F2                 &kp F3                 &kp F4                  &kp F5                                                                                                                     &kp F6                   &kp F7                   &kp F8                  &kp F9                  &kp F10
&kp ESC     &kp N1                 &kp N2                 &kp N3                  &kp N4                  &kp N5                                                                                     &kp N6  &kp N7                   &kp N8                   &kp N9                  &kp N0                  &magic 6 0
&caps_word  &kp Q                  &kp W                  &kp F                   &kp P                   &kp B                                                                                      &kp J   &kp L                    &kp U                    &kp Y                   &danish_ae_AE           &lower
&kp TAB     &home_mod_left LGUI A  &home_mod_left LALT R  &home_mod_left LCTRL S  &home_mod_left LSHFT T  &kp G                                                                                      &kp M   &home_mod_right RSHFT N  &home_mod_right RCTRL E  &home_mod_right RALT I  &home_mod_right LGUI O  &danish_oe_OE
&kp LSHFT   &kp Z                  &kp X                  &kp C                   &kp D                   &kp V   &kp LS(TAB)      &kp LALT   &tog 4        &tog 3     &kp RIGHT_SHIFT  &kp TAB      &kp K   &kp H                    &kp COMMA                &kp DOT                 &danish_aa_AA           &kp LGUI
&kp LCTRL   &kp HOME               &kp END                &kp LEFT                &kp RIGHT                       &lt 2 BACKSPACE  &lt 1 DEL  &kp LEFT_GUI  &kp RCTRL  &lt 2 ENTER      &lt 1 SPACE          &kp UP                   &kp DOWN                 &kp PAGE_UP             &kp PAGE_DOWN           &kp RALT
            >;
        };

        layer_Symbols {
            bindings = <
&trans  &trans          &trans            &trans                &trans                                                                                            &trans             &trans         &trans           &trans     &trans
&trans  &trans          &trans            &trans                &trans                 &trans                                                      &trans         &trans             &trans         &trans           &trans     &trans
&trans  &kp CARET       &kp PLUS          &kp LEFT_BRACKET      &kp RIGHT_BRACKET      &kp DOLLAR                                                  &kp PIPE       &kp DOUBLE_QUOTES  &kp SEMICOLON  &kp EXCLAMATION  &kp GRAVE  &trans
&trans  &kp UNDERSCORE  &kp MINUS         &kp LEFT_PARENTHESIS  &kp RIGHT_PARENTHESIS  &kp EQUAL                                                   &kp AMPS       &kp SQT            &kp COLON      &kp QUESTION     &kp AT     &trans
&trans  &kp LESS_THAN   &kp GREATER_THAN  &kp LEFT_BRACE        &kp RIGHT_BRACE        &kp TILDE   &trans  &trans  &trans  &trans  &trans  &trans  &kp BACKSLASH  &kp SLASH          &kp PERCENT    &kp ASTERISK     &kp HASH   &trans
&trans  &trans          &trans            &trans                &trans                             &trans  &trans  &trans  &trans  &trans  &trans                 &trans             &trans         &trans           &trans     &trans
            >;
        };

        layer_Numeric {
            bindings = <
&trans  &trans     &trans        &trans  &trans                                                                  &trans  &trans  &trans  &trans   &trans
&trans  &trans     &trans        &trans  &trans  &trans                                                  &trans  &trans  &trans  &trans  &trans   &trans
&trans  &trans     &kp N7        &kp N8  &kp N9  &trans                                                  &trans  &kp N7  &kp N8  &kp N9  &trans   &trans
&trans  &kp N0     &kp NUMBER_4  &kp N5  &kp N6  &trans                                                  &trans  &kp N4  &kp N5  &kp N6  &kp N0   &trans
&trans  &kp COMMA  &kp N1        &kp N2  &kp N3  &trans  &trans  &trans  &trans  &trans  &trans  &trans  &trans  &kp N1  &kp N2  &kp N3  &kp DOT  &trans
&trans  &trans     &trans        &trans  &trans          &trans  &trans  &trans  &trans  &trans  &trans          &trans  &trans  &trans  &trans   &trans
            >;
        };

        layer_Mouse {
            bindings = <
&trans  &trans  &trans  &trans  &trans                                                                                            &none                &none          &none                &none          &none
&trans  &trans  &trans  &trans  &trans  &trans                                                                         &none      &none                &none          &none                &none          &none
&trans  &trans  &trans  &trans  &trans  &trans                                                                         &kp KP_N7  &kp LC(KP_NUMBER_4)  &kp LC(KP_N8)  &kp LC(KP_NUMBER_2)  &kp LC(KP_N6)  &kp KP_N9
&trans  &trans  &trans  &trans  &trans  &trans                                                                         &none      &kp KP_N4            &kp KP_N8      &kp KP_N2            &kp KP_N6      &none
&trans  &trans  &trans  &trans  &trans  &trans  &trans  &trans  &trans  &trans              &kp KP_DOT    &kp KP_N0    &kp KP_N1  &kp LS(KP_NUMBER_4)  &kp LS(KP_N8)  &kp LS(KP_N2)        &kp LS(KP_N6)  &kp KP_NUMBER_3
&trans  &trans  &trans  &trans  &trans          &trans  &trans  &trans  &left_double_click  &right_click  &left_click             &trans               &trans         &trans               &trans         &none
            >;
        };

        layer_Nav {
            bindings = <
&trans  &trans     &trans     &trans     &trans                                                                         &trans  &trans  &trans  &trans  &trans
&trans  &trans     &trans     &trans     &trans     &trans                                                      &trans  &trans  &trans  &trans  &trans  &trans
&trans  &kp PG_UP  &kp HOME   &kp UP     &kp END    &kp SPACE                                                   &trans  &trans  &trans  &trans  &trans  &trans
&trans  &kp PG_DN  &kp LEFT   &kp DOWN   &kp RIGHT  &kp RETURN                                                  &trans  &trans  &trans  &trans  &trans  &trans
&trans  &kp LC(Z)  &kp LC(X)  &kp LC(C)  &kp LC(V)  &kp LC(Y)   &trans  &trans  &trans  &trans  &trans  &trans  &trans  &trans  &trans  &trans  &trans  &trans
&trans  &trans     &trans     &trans     &trans                 &trans  &trans  &trans  &trans  &trans  &trans          &trans  &trans  &trans  &trans  &trans
            >;
        };

        layer_Lower {
            bindings = <
&trans      &trans        &trans      &trans        &trans                                                                        &trans   &trans   &trans   &trans           &trans
&trans      &trans        &trans      &trans        &trans        &trans                                                  &trans  &trans   &trans   &trans   &trans           &trans
&kp CAPS    &kp C_BRI_UP  &kp C_MUTE  &kp C_VOL_DN  &kp C_VOL_UP  &trans                                                  &kp F1  &kp F2   &kp F3   &kp F4   &kp PAUSE_BREAK  &trans
&kp K_CALC  &kp C_BRI_DN  &kp C_PREV  &kp C_PAUSE   &kp C_NEXT    &trans                                                  &kp F5  &kp F6   &kp F7   &kp F8   &kp PSCRN        &trans
&trans      &kp K_APP     &trans      &trans        &trans        &trans  &trans  &trans  &to 0   &trans  &trans  &trans  &kp F9  &kp F10  &kp F11  &kp F12  &kp SLCK         &trans
&magic 6 0  &trans        &trans      &trans        &trans                &trans  &trans  &trans  &trans  &trans  &trans          &trans   &trans   &trans   &trans           &trans
            >;
        };

        layer_Magic {
            bindings = <
&bt BT_CLR   &none            &none            &none            &none                                                                                     &none  &none  &none  &none  &bt BT_CLR_ALL
&none        &none            &none            &none            &none            &none                                                             &none  &none  &none  &none  &none  &none
&none        &rgb_ug RGB_SPI  &rgb_ug RGB_SAI  &rgb_ug RGB_HUI  &rgb_ug RGB_BRI  &rgb_ug RGB_TOG                                                   &none  &none  &none  &none  &none  &none
&bootloader  &rgb_ug RGB_SPD  &rgb_ug RGB_SAD  &rgb_ug RGB_HUD  &rgb_ug RGB_BRD  &rgb_ug RGB_EFF                                                   &none  &none  &none  &none  &none  &bootloader
&reset       &none            &none            &none            &none            &none            &bt_2  &bt_3  &none         &none  &none  &none  &none  &none  &none  &none  &none  &reset
&none        &none            &none            &none            &none                             &bt_0  &bt_1  &out OUT_USB  &none  &none  &none         &none  &none  &none  &none  &none
            >;
        };
    };
};
